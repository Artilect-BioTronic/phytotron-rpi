#include "Arduino.h"

#include "pseudoFile.h"

#include "msgSerial.h"

/*---------------------------------------------------------------*/
/*                                          */
/*---------------------------------------------------------------*/


int PseudoFile::available()   {
    return size_ - pos_;
}

int PseudoFile::peek()   {
    if ( (pos_ < size_) && (isOpened_) )
        return generateCharInFile(pos_);
    else
        return -1;
}

int PseudoFile::read()   {
    int achar = peek();
    pos_++ ;
    return achar;
}

int PseudoFile::close()   {isOpened_ = false; return 0;}

int PseudoFile::open(const String& fileName)
{
    // we check it is the name of a fake
    if (fileName.equals("fake"))   {
        // we put index back to 1st line
        lineNum_ = 0;
        pos_ = 0;
        isOpened_ = true;
        return 0;
    }
    else
        return -1;
}

// the file is read until \n char, string goes in readString
// returns the number of read char,  0 if none, -1 if error
//int PseudoFile::readln(String& readString)
//{
//    // it is a fake file
//    // line are generated by generateLine
//    readString = generateLine(_lineNum);

//    // we increment index
//    lineNum_++;

//    return readString.length();
//}

int PseudoFile::generateCharInFile(int aPos)   {
    // we limit size to 3 lines
    if (aPos >= size_)
        return 0;
    else   {
        if ( (aPos % 10 == 0) && (aPos != 0) )
            return '\n';
        else if (aPos % 10 == 1)
            return '1';
        else  {
            if (aPos % 2 == 0)
                return (aPos /2) /10 + 48;  // conversion to ascii num with +48
            else
                return (aPos /2) %10 + 48;
        }
    }
}

//String PseudoFile::generateLine(int numLine)   {
//    // we limit size to 3 lines
//    if (_lineNum >=3)
//        return "";
//    else
//        return String("line num ")+ _lineNum + ": " + _lineNum*2;
//}

